/* Syncrhonized Micromotor Driver Control
*  Author: Ian Thompson 
*  Email: ianapthompson@gmail.com
*  Date: June 28th, 2017
*
*  Page references given in the code are in reference to the Datasheet/Manual for the ATmega32U4 
*  microcontroller found on the Arduino micro. See http://www.atmel.com/Images/Atmel-7766-8-bit-AVR-ATmega16U4-32U4_Datasheet.pdf
*/

#include <avr/pgmspace.h>

// Configure the locations of the various pins used
#define TRIGGER_PIN 2
#define COUNTER_CLEAR_PIN 4

#define SWITCH_HIGH 5
#define SWITCH_PIN 6
#define SWITCH_LOW 7

#define PWM_PIN_A 9
#define PWM_PIN_B 10
#define PWM_PIN_C 11

// Set important constants
static const long approxFreqHz = 100000; //Hz, the estimated pulse frequency from the laser source
static const long clockFreq = 16000000; // Hz, the internal clock frequency of the Microcontroller

static const int numFramesMax = 2048; // The maximum number of frames per revolution, limited by lookup table storage
static const int numFrames = 1024; // Number of A-lines per revolution. Must be a factor of numFramesMax

static const int counterPrescale = 16; // The factor of downsampling in the counter circuit. In this case we use the 1/16 output. 
static const int timerPrescale = 256; // The clock downsampling used in the spinup function. Set with CS3x bits in TCCR3B (pg.133)

static const int framePrescale = numFramesMax/numFrames*counterPrescale; // Calculate the size of increment through the lookup 
                                                                         // table to give the desired frequency. 

// Set the time taken in different portions of spinUpMotor. 
static const int updateDelayFast = 25;
static const int updateDelayMid = 100;
static const int updateDelaySlow = 200;

// Store the large sine lookup table in Flash Program memory. A .txt version of this table was created with the 
// genSineLUT.m MATLAB script. This table contains two periods of the sine to prevent out of bounds issues. This table 
// contains the pre-set information on the amplitude and commmon mode of the output sine wave. 
static unsigned int sineLookUp[] PROGMEM = { 77 , 77 , 78 , 78 , 78 , 78 , 78 , 79 , 79 , 79 , 79 , 80 , 80 , 80 , 80 , 81 ,
	 81 , 81 , 81 , 82 , 82 , 82 , 82 , 82 , 83 , 83 , 83 , 83 , 84 , 84 , 84 , 84 ,
	 85 , 85 , 85 , 85 , 85 , 86 , 86 , 86 , 86 , 87 , 87 , 87 , 87 , 88 , 88 , 88 ,
	 88 , 89 , 89 , 89 , 89 , 89 , 90 , 90 , 90 , 90 , 91 , 91 , 91 , 91 , 92 , 92 ,
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	 73 , 74 , 74 , 74 , 74 , 74 , 75 , 75 , 75 , 75 , 76 , 76 , 76 , 76 , 77 , 77};

void setup() 
{
  // Configure pins:
  
  // Set pin to clear input counter
  pinMode(COUNTER_CLEAR_PIN, OUTPUT);
  
  // Set pin for reading in trigger signals
  pinMode(TRIGGER_PIN, INPUT);
  
  // Setup the switch as an input with HIGH on one connection, LOW on other
  pinMode(SWITCH_LOW, OUTPUT);
  pinMode(SWITCH_PIN, INPUT);
  pinMode(SWITCH_HIGH, OUTPUT);
  digitalWrite(SWITCH_LOW, LOW);
  digitalWrite(SWITCH_HIGH, HIGH);
  
  // Setup pins to output sinusoidal driving PWM
  pinMode(PWM_PIN_A, OUTPUT);
  pinMode(PWM_PIN_B, OUTPUT);
  pinMode(PWM_PIN_C, OUTPUT);
  
  
  // Enable Interrupt
  EIMSK &= ~(1<<INT1); //Clear INT1 Bit, disabling external interrupt 1 (pg. 90)
  EICRA |= (1<<ISC10)|(1<<ISC11); // Set external interrupt trigger on rising edge (pg.89)
  SREG |= B10000000; // Globally turn on interrupts for the whole chip (pg.11)
  
  // Set-up the sinusoidal driving output PWM to be Non-Inverting, 8-bit, FastPWM, with mo clock prescale
  // We use timer 1 to implement the output PWM as it can support 3 compare units for 3 outputs
  TCCR1A = B10101001; // See Pg. 131 for explanation of these bit settings
  TCCR1B = B01001001; // See Pg. 133 
  
  // Set the outputs to initial steady state values to move the motor into starting position
  OCR1A = pgm_read_word_near(sineLookUp);
  OCR1B = pgm_read_word_near(sineLookUp + numFramesMax/3);
  OCR1C = pgm_read_word_near(sineLookUp + numFramesMax*2/3);
 
  
  // Wait for switch to be flicked on then off to start the motor
  while(!digitalRead(SWITCH_PIN)){}
  while(digitalRead(SWITCH_PIN)){}
  
  // Clear the counting chip
  digitalWrite(COUNTER_CLEAR_PIN, LOW);
  
  // Begin the spinup process up to the approx. target frequency specified as a constant. 
  spinUpMotor(approxFreqHz);
  
  // Switch control of the motors from the spinup code to the laser trigger signal
  EIMSK |= (1<<INT1); //Set INT1 Bit to enable the external interrupt 1. (pg. 90)
  
  // Turn on the counter chip to start the trigger signal into the Arduino
  digitalWrite(COUNTER_CLEAR_PIN, HIGH);
}

void loop() 
{
  // Loop is empty since code relies only on interrupts
}

// The spinUp function allows the motor to smoothly increase in frequency up to a target trigger frequency
// NOTE: this target frequency refers to the estimated frequency of the laser trigger (ie 100kHz), not the
//       estimated rotational frequency of the motor
void spinUpMotor(long desiredFreqHz)
{
  // The number of timer 3 ticks corresponding to the desired frequency is calculated.
  // Casting and order of operations is important to avoid truncation or overflow issues
  double scaleDown = (double)(clockFreq/desiredFreqHz);
  int minCompare = (int)(scaleDown/2/timerPrescale*counterPrescale);
  
  // We use timer 3 for this process. 
  TCCR3A = 0; // Clear timer 3 settings (pg. 131)
  TCCR3B = 0; // Stop the clock input to timer so it stops running (pg. 133)
  TIMSK3 = 0; // Clear timer's interrupt settings (pg. 137)
  TIMSK3 |= (1<<OCIE3A); // Enable the output compare match A interrupt (pg. 138) 
  TCCR3A |= (1<<COM3A0); // Set timer to toggle the output compare bit on a match (pg. 131)
  TCCR3B |= (1<<WGM32)|(1<<CS32); // Set timer in CTC (Clear Timer on Compare Match) Mode with 1/256 clock prescaler (pg. 133)
  
  // Slowly increase the frequency to the desired maximum by slowly decreasing the number of ticks the timer counts before 
  // it rolls over and increments the sine wave output. 
  int updateDelay;
  for (int compare = 255; compare > minCompare; --compare)
  {
      // Track elapsed time for pauses using millis() instead of delay() to avoid interrupt issues
      long prevTime = millis();
      
      // Because frequency scales with 1/compare, we need to spend longer on the final decrements of the compare interval in 
      // order to achieve more uniform acceleration. 
      if(compare - minCompare > 50) updateDelay = updateDelayFast;
      else if(compare - minCompare > 5) updateDelay = updateDelayMid;
      else updateDelay = updateDelaySlow;
      
      // Wait the set time interval determined above
      while(millis() < prevTime + updateDelay) ;
      
      TCCR3B &= ~(1<<CS32); // Pause the timer (pg. 133)
      OCR3A = compare; // Set the new number of ticks for a slightly increased frequency (pg. 136)
      TCNT3 = 0; // Reset the timer value (pg. 135)
      TCCR3B |= (1<<CS32); // Start the timer
  }
  
  // After the spinup process is finished, turn off the timer 3 interrupt (pg. 137)
  TIMSK3 &= ~(1<<OCIE3A);
  return;
}

// Every rising edge on the external interrupt pin 1 triggers this interrupt service routine
ISR(INT1_vect) 
{
  // Save status register while interrupt occurs to prevent accidental modification
  char tSREG = SREG;
  // Increment the sine wave signal
  incrementSines();
  // Re-load the original status register
  SREG = tSREG;
}

// Every time timer 3 rolls over, this interrupt service routine is run
ISR(TIMER3_COMPA_vect)
{
  // Save status register while interrupt occurs
  char tSREG = SREG;
  // Increment the sine wave signal
  incrementSines();
  // Re-load the original status register
  SREG = tSREG;
}

// This function increments the sine wave output signal by setting the three output PWM signals to the next
// duty cycle value in the sine wave approximation table
void incrementSines()
{
  // The phase of the sine wave is set to static so that the value is maintained between calls to this function
  static int phase;
  
  // Set the next duty cycle for the outputs, offset by 120 deg. phases. The duty cycles are read from program memory
  OCR1A = pgm_read_word_near(sineLookUp + phase);
  OCR1B = pgm_read_word_near(sineLookUp + phase + numFramesMax/3);
  OCR1C = pgm_read_word_near(sineLookUp + phase + numFramesMax*2/3);
  
  // Increment the phase by the predetermined prescale value. This new phase will be used for the next increment
  phase += framePrescale;
  // Reset phase every period to handle overflow out of the table
  if( phase >= numFramesMax )
  {
    phase = 0; 
  }
  return;
}
