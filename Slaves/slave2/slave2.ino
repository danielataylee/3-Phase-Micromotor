//Slave2 - Laptop: Comm15 / PC: Comm7 - Channel B (Red)

/*
Date: May 2018
Organization: BCCRC Imaging Unit
Authors: Varalee Chinbomsom and Daniela Tay Lee Sanchez
Description: Ramps up at one lookup table skipping clock pulses
*/

//Constants
#define DAC_RESOLUTION 12
#define PIN_SIGNAL 51
#define DAC DAC1


//Variables
volatile int i = 0; //Iterate through wave values for sine wave
volatile unsigned char mastersig = 0; //Signal to receive from master
volatile int samples = 0;
volatile int k = 0; //For testing fixed
volatile int count = 0; //counts clock ticks to skip
volatile int pulse = 6; //Start skipping this many ticks
volatile int points = 0; //Points outputted
volatile int cycles = 180; //Num of cycles to complete on each ramp up

//Lookup tables
static int * wave; //To choose table

static int wave_1000[1000] = 
{
3833,3827,3821,3814,3808,3801,3794,3788,3781,3774,3767,3760,3753,3746,3738,3731,3724,3716,3709,
3701,3694,3686,3678,3670,3663,3655,3647,3639,3630,3622,3614,3606,3597,3589,3580,3572,3563,3554,3546,3537,3528,3519,3510,3501,
3492,3483,3474,3464,3455,3446,3436,3427,3417,3407,3398,3388,3378,3369,3359,3349,3339,3329,3319,3309,3298,3288,3278,3268,3257,
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3870,3864,3858,3852,3846,3840
};

static int wave_500[500] =
{
3850,3838,3825,3812,3799,3785,3772,3758,3743,3729,3714,
3699,3683,3668,3652,3636,3619,3603,3586,3569,3551,3534,3516,3498,3479,3461,3442,3423,3404,3384,3365,3345,3325,3305,3284,3263,
3243,3222,3200,3179,3157,3136,3114,3092,3069,3047,3024,3002,2979,2956,2933,2909,2886,2862,2838,2815,2791,2767,2742,2718,2694,
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3992,3984,3976,3967,3958,3948,3939,3928,3918,3908,3897,3885,3874,3862
};

//Method to configure Arduino
void setup() 
{
   //Set pins as inputs or outputs
   pinMode(DAC, OUTPUT);   
   pinMode(PIN_SIGNAL, INPUT); 
   analogWriteResolution(DAC_RESOLUTION); //Set up resolution
   attachInterrupt(digitalPinToInterrupt(PIN_SIGNAL), PIN_ISR, RISING); //Call pin_ISR when 51 goes from low to high
}

//Method to loop indefinetely
void loop() 
{
    //Start after 1000 clock ticks
    if (k == 1000) 
    {
      mastersig = 1; //start
      wave = wave_1000;
      samples=1000;
    }
    
}

//Interrupt method, everytime the pin goes low to high
void PIN_ISR() 
{ 
  
  k++;
  
  if (mastersig == 1) 
  {
    if (count >= pulse) //If skip pulse number of pulses
    {
      analogWrite(DAC, wave[i]); //Write on DAC
      i = (i+1)%samples;
      points++; //Wrote a point

      count = -1; //Restart count of clock ticks, increase at end so start -1
      
      if ((pulse >= 1) && (points == samples*cycles)) //If still want to skip 2 pulses
      {
        pulse--; //Decrease pulses to skip
        points=0; //restar points written    
      }

      else if (pulse == 0)//Now we are supossed to skip 0 pulses
      {
        //First skip, out, out, skip, out, out, skip, out out
        if (points < samples*cycles) //Only for those cycles, then it will not skip clocks bc count is always greater
        {
          if ((points%3) == 0) //want to skip 1 point
            count = -2; //Skip once be -1 on top so skips, then 0 so outputs
          else 
            count = -1; //Do output point
        }
      }
    }//End if count>= pulse

    count++;
    
  }//End if mastersig is 1
 
  else
    analogWrite(DAC1, 0); //Just output value 0 (line) if signal to start is not
}

